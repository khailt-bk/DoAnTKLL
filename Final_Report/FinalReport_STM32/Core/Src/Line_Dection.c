/*
 * Line_Dection.c
 *
 *  Created on: Dec 17, 2022
 *      Author: ASUS
 */

#include "Line_Dection.h"
int Image_Matrix[50][100] = {



		 { 1,1,1,0,1,1,0,0,0,1,0,0,0,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0,0 } ,
		 { 0,0,0,1,0,0,0,1,1,1,0,0,0,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0,0 } ,
		 { 1,0,0,1,1,0,0,0,0,0,1,0,0,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0,0 } ,
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		 { 0,0,0,0,0,0,0,0,0,0,0,0,0,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0,0 } ,


};

void Create_LineMatrix(){
	for(int i= 0; i< height; i++){
		for(int j= 0; j< width; j++){
			Line_Matrix[i][j] = 0;
		}
	}
}

void Create_VoteTable(){
	for(int i= 0; i< a; i++){
		for(int j= 0; j< 2*r+ 1; j++){
			Vote_Matrix[i][j] = 0;
		}
	}
}
int timer_flag = 0;

void HoughTransform( ){
	timer_flag = 1;
	UART_Time();
    for(int x = 0 ; x < width ; x++ ){
        for(int y = 0 ; y < height ; y++){
            if( Image_Matrix[y][x] == 1){
                for(int i = 0; i < 180 ; i+=4){
                    // theta
                    float Angle = i*pi/180;
                    // p
                    float Distance = ((float) x)*cos(Angle) + ((float) y)*sin(Angle);
                    // round
                    int column = ceilf(Distance)+ r ;
                    int row = i/4;
                    Vote_Matrix[row][column]++;
                }
            }
        }
    }
    timer_flag= 2;
	UART_Time();
}

void Get_ImageLine(){
	timer_flag = 3;
	UART_Time();
    for(int x = 0 ; x < width ; x++ ){
        for(int y = 0 ; y < height ; y++){
            if( Image_Matrix[y][x] == 1){
                for(int i = 0; i < 180 ; i+=4){
                    // theta
                    float angle = i*pi/180;
                    // p
                    float Distance = ((float) x)*cos(angle) + ((float) y)*sin(angle);
                    // round
                    int column = ceilf(Distance)+ r ;
                    int row = i/4;
                    if(  Vote_Matrix[row][column] >= threshold){
                    	Line_Matrix[y][x] = 1;
                    }
                }
            }
        }
    }
    timer_flag = 4;
    UART_Time();
}
